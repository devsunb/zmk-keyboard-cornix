## boards/shields/cornix_dongle_eyelash/Kconfig.defconfig
```kconfig
if SHIELD_CORNIX_DONGLE_EYELASH

config CORNIX_DONGLE_DISPLAY_ROTATION_180
    bool "Rotate display 180 degrees"
    default y
    help
        Enable to rotate the display 180 degrees.
        Disable for 0 degrees (original orientation).

if ZMK_DISPLAY

config I2C
    default y

endif # ZMK_DISPLAY

if LVGL

config LV_Z_VDB_SIZE
    default 64

config LV_DPI_DEF
    default 148

config LV_Z_BITS_PER_PIXEL
    default 1

choice LV_COLOR_DEPTH
    default LV_COLOR_DEPTH_1
endchoice

endif # LVGL

endif # END ALL

#vim: set ft=kconfig:
```
